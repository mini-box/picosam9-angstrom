## conf/layer.conf
```bitbake
# We have a conf and classes directory, append to BBPATH
BBPATH .= ":${LAYERDIR}"

# We have a recipes directory containing .bb and .bbappend files, add to BBFILES
BBFILES += "${LAYERDIR}/recipes*/*/*.bb \ 
            ${LAYERDIR}/recipes*/*/*.bbappend"

BBFILE_COLLECTIONS += "picosam9"
BBFILE_PATTERN_picosam9 = "^${LAYERDIR}/"
BBFILE_PRIORITY_picosam9 = "6"
```

## conf/machine/picosam9.conf
```bitbake
#@TYPE: Machine
#@NAME: picoSAM9 Development Board
#@DESCRIPTION: Machine configuration for the picosam9 http://arm.mini-box.com/ board

TARGET_ARCH = "arm"

require conf/machine/include/tune-arm926ejs.inc

GUI_MACHINE_CLASS = "bigscreen"

IMAGE_FSTYPES += "tar.bz2"

SERIAL_CONSOLE = "115200 ttyS0"

PREFERRED_PROVIDER_virtual/kernel = "picosam9"

PREFERRED_PROVIDER_virtual/xserver = "xserver-xorg"

XSERVER = " \
	xserver-xorg \
	xf86-input-evdev \
	xf86-input-mouse \
	xf86-input-keyboard \
	xf86-video-fbdev \
"

KERNEL_IMAGETYPE = "uImage"

MACHINE_FEATURES = "kernel26 apm usbgadget usbhost keyboard vfat ext2 screen touchscreen alsa bluetooth wifi"

USE_VT="0"
```
